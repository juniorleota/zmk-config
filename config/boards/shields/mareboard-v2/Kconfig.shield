## config/boards/shields/mareboard-v2/Kconfig.shield
```kconfig
# Copyright (c) 2020 The ZMK Contributors
# SPDX-License-Identifier: MIT

config SHIELD_MAREBOARD_LEFT
    def_bool $(shields_list_contains,mareboard_left)

config SHIELD_MAREBOARD_RIGHT
    def_bool $(shields_list_contains,mareboard_right)
```

## config/boards/shields/mareboard/Kconfig.defconfig
```kconfig
# Copyright (c) 2020 The ZMK Contributors
# SPDX-License-Identifier: MIT

config ZMK_KEYBOARD_NAME
	default "Mareboard"

if SHIELD_MAREBOARD_RIGHT

config ZMK_SPLIT_ROLE_CENTRAL
	default y

endif

if SHIELD_MAREBOARD_LEFT || SHIELD_MAREBOARD_RIGHT

config ZMK_SPLIT
	default y

endif
```
